## sample.yaml
```
sample:
  description: Hello world, but for D
  name: ldc_hello
common:
  build_only: true
  platform_allow:
    - qemu_cortex_m3
tests:
  app.default: {}
```

## prj.conf
```kconfig
CONFIG_NEWLIB_LIBC=y
CONFIG_NEWLIB_LIBC_FLOAT_PRINTF=y
CONFIG_NEWLIB_LIBC_FLOAT_SCANF=y
```

## src/main.c
```c
extern __attribute__((noreturn)) void d_main();

int main() {
    d_main();
    return 0;
}
```
